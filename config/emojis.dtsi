/ {
    macros {
        // Grinning Squinting Face (😆)
        grin_squint: grin_squint {
            compatible = "zmk,behavior-macro";
            #binding-cells = <0>;
            tap-ms = <0>;
            wait-ms = <0>;
            bindings = <&macro_press &kp LCTRL &kp LSHFT>,
                       <&macro_tap &kp U>,
                       <&macro_release &kp LCTRL &kp LSHFT>,
                       <&macro_tap &kp N1 &kp F &kp N6 &kp N0 &kp N6 &kp SPC>;
        };

        // Winking Face (😉)
        wink: wink {
            compatible = "zmk,behavior-macro";
            #binding-cells = <0>;
            tap-ms = <0>;
            wait-ms = <0>;
            bindings = <&macro_press &kp LCTRL &kp LSHFT>,
                       <&macro_tap &kp U>,
                       <&macro_release &kp LCTRL &kp LSHFT>,
                       <&macro_tap &kp N1 &kp F &kp N6 &kp N0 &kp N9 &kp SPC>;
        };

        // Smiling Face with Smiling Eyes (😊)
        smile_eyes: smile_eyes {
            compatible = "zmk,behavior-macro";
            #binding-cells = <0>;
            tap-ms = <0>;
            wait-ms = <0>;
            bindings = <&macro_press &kp LCTRL &kp LSHFT>,
                       <&macro_tap &kp U>,
                       <&macro_release &kp LCTRL &kp LSHFT>,
                       <&macro_tap &kp N1 &kp F &kp N6 &kp N0 &kp A &kp SPC>;
        };

        // Heart Eyes (😍)
        heart_eyes: heart_eyes {
            compatible = "zmk,behavior-macro";
            #binding-cells = <0>;
            tap-ms = <0>;
            wait-ms = <0>;
            bindings = <&macro_press &kp LCTRL &kp LSHFT>,
                       <&macro_tap &kp U>,
                       <&macro_release &kp LCTRL &kp LSHFT>,
                       <&macro_tap &kp N1 &kp F &kp N6 &kp N0 &kp D &kp SPC>;
        };

        // Thinking Face (🤔)
        thinking: thinking {
            compatible = "zmk,behavior-macro";
            #binding-cells = <0>;
            tap-ms = <0>;
            wait-ms = <0>;
            bindings = <&macro_press &kp LCTRL &kp LSHFT>,
                       <&macro_tap &kp U>,
                       <&macro_release &kp LCTRL &kp LSHFT>,
                       <&macro_tap &kp N1 &kp F &kp N9 &kp N1 &kp N4 &kp SPC>;
        };

        // Grinning Face with Sweat (😅)
        grin_sweat: grin_sweat {
            compatible = "zmk,behavior-macro";
            #binding-cells = <0>;
            tap-ms = <0>;
            wait-ms = <0>;
            bindings = <&macro_press &kp LCTRL &kp LSHFT>,
                       <&macro_tap &kp U>,
                       <&macro_release &kp LCTRL &kp LSHFT>,
                       <&macro_tap &kp N1 &kp F &kp N6 &kp N0 &kp N5 &kp SPC>;

        // Upside-Down Face (🙃)
        upside_down: upside_down {
            compatible = "zmk,behavior-macro";
            #binding-cells = <0>;
            tap-ms = <0>;
            wait-ms = <0>;
            bindings = <&macro_press &kp LCTRL &kp LSHFT>,
                       <&macro_tap &kp U>,
                       <&macro_release &kp LCTRL &kp LSHFT>,
                       <&macro_tap &kp N1 &kp F &kp N6 &kp N4 &kp N3 &kp SPC>;
        };

        // Smiling Face with Horns (😈)
        smiling_imp: smiling_imp {
            compatible = "zmk,behavior-macro";
            #binding-cells = <0>;
            tap-ms = <0>;
            wait-ms = <0>;
            bindings = <&macro_press &kp LCTRL &kp LSHFT>,
                       <&macro_tap &kp U>,
                       <&macro_release &kp LCTRL &kp LSHFT>, 
                       <&macro_tap &kp N1 &kp F &kp N6 &kp N0 &kp N8 &kp SPC>;
        };

        // Face with Hand Over Mouth (🤭)
        hand_over_mouth: hand_over_mouth {
            compatible = "zmk,behavior-macro";
            #binding-cells = <0>;
            tap-ms = <0>;
            wait-ms = <0>;
            bindings = <&macro_press &kp LCTRL &kp LSHFT>,
                       <&macro_tap &kp U>,
                       <&macro_release &kp LCTRL &kp LSHFT>,
                       <&macro_tap &kp N1 &kp F &kp N9 &kp N2 &kp D &kp SPC>;
        };

        // Pleading Face (🥺)
        pleading: pleading {
          compatible = "zmk,behavior-macro";
          #binding-cells = <0>;
            tap-ms = <0>;
            wait-ms = <0>;
            bindings = <&macro_press &kp LCTRL &kp LSHFT>,
                       <&macro_tap &kp U>,
                       <&macro_release &kp LCTRL &kp LSHFT>,
                       <&macro_tap &kp N1 &kp F &kp N9 &kp N7 &kp A &kp SPC>;
        }

        // Party Popper (🥳)
        party: party {
            compatible = "zmk,behavior-macro";
            #binding-cells = <0>;
            tap-ms = <0>;
            wait-ms = <0>;
            bindings = <&macro_press &kp LCTRL &kp LSHFT>,
                       <&macro_tap &kp U>,
                       <&macro_release &kp LCTRL &kp LSHFT>,
                       <&macro_tap &kp N1 &kp F &kp N9 &kp N7 &kp N3 &kp SPC>;
        };

        // Star-Struck (🤩)
        star_struck: star_struck {
            compatible = "zmk,behavior-macro";
            #binding-cells = <0>;
            tap-ms = <0>;
            wait-ms = <0>;
            bindings = <&macro_press &kp LCTRL &kp LSHFT>,
                       <&macro_tap &kp U>,
                       <&macro_release &kp LCTRL &kp LSHFT>,
                       <&macro_tap &kp N1 &kp F &kp N9 &kp N2 &kp N9 &kp SPC>;
        };

        // Sob (😭)
        sob: sob {
            compatible = "zmk,behavior-macro";
            #binding-cells = <0>;
            tap-ms = <0>;
            wait-ms = <0>;
            bindings = <&macro_press &kp LCTRL &kp LSHFT>,
                       <&macro_tap &kp U>,
                       <&macro_release &kp LCTRL &kp LSHFT>,
                       <&macro_tap &kp N1 &kp F &kp N6 &kp N2 &kp D &kp SPC>;
        };

        // Smirk (😏)
        smirk: smirk {
            compatible = "zmk,behavior-macro";
            #binding-cells = <0>;
            tap-ms = <0>;
            wait-ms = <0>;
            bindings = <&macro_press &kp LCTRL &kp LSHFT>,
                       <&macro_tap &kp U>,
                       <&macro_release &kp LCTRL &kp LSHFT>,
                       <&macro_tap &kp N1 &kp F &kp N6 &kp N0 &kp F &kp SPC>;
        };

        // Rolling on the Floor Laughing (🤣)
        rofl: rofl {
            compatible = "zmk,behavior-macro";
            #binding-cells = <0>;
            tap-ms = <0>;
            wait-ms = <0>;
            bindings = <&macro_press &kp LCTRL &kp LSHFT>,
                       <&macro_tap &kp U>,
                       <&macro_release &kp LCTRL &kp LSHFT>,
                       <&macro_tap &kp N1 &kp F &kp N9 &kp N2 &kp N3 &kp SPC>;
        };

        // Grinning Face with Smiling Eyes (😄)
        grin_smiling_eyes: grin_smiling_eyes {
            compatible = "zmk,behavior-macro";
            #binding-cells = <0>;
            tap-ms = <0>;
            wait-ms = <0>;
            bindings = <&macro_press &kp LCTRL &kp LSHFT>,
                       <&macro_tap &kp U>,
                       <&macro_release &kp LCTRL &kp LSHFT>,
                       <&macro_tap &kp N1 &kp F &kp N6 &kp N0 &kp N4 &kp SPC>;
        };

        // Hugging Face (🤗)
        hug: hug {
            compatible = "zmk,behavior-macro";
            #binding-cells = <0>;
            tap-ms = <0>;
            wait-ms = <0>;
            bindings = <&macro_press &kp LCTRL &kp LSHFT>,
                       <&macro_tap &kp U>,
                       <&macro_release &kp LCTRL &kp LSHFT>,
                       <&macro_tap &kp N1 &kp F &kp N9 &kp N1 &kp N7 &kp SPC>;
        };

        // Face with Tears of Joy (😂)
        joy: joy {
            compatible = "zmk,behavior-macro";
            #binding-cells = <0>;
            tap-ms = <0>;
            wait-ms = <0>;
            bindings = <&macro_press &kp LCTRL &kp LSHFT>,
                       <&macro_tap &kp U>,
                       <&macro_release &kp LCTRL &kp LSHFT>,
                       <&macro_tap &kp N1 &kp F &kp N6 &kp N0 &kp N2 &kp SPC>;
        };

        // Face Blowing a Kiss (😘)
        kiss: kiss {
            compatible = "zmk,behavior-macro";
            #binding-cells = <0>;
            tap-ms = <0>;
            wait-ms = <0>;
            bindings = <&macro_press &kp LCTRL &kp LSHFT>,
                       <&macro_tap &kp U>,
                       <&macro_release &kp LCTRL &kp LSHFT>,
                       <&macro_tap &kp N1 &kp F &kp N6 &kp N1 &kp N8 &kp SPC>;
        };

        // Smiling Face with Hearts (🥰)
        smile_hearts: smile_hearts {
            compatible = "zmk,behavior-macro";
            #binding-cells = <0>;
            tap-ms = <0>;
            wait-ms = <0>;
            bindings = <&macro_press &kp LCTRL &kp LSHFT>,
                       <&macro_tap &kp U>,
                       <&macro_release &kp LCTRL &kp LSHFT>,
                       <&macro_tap &kp N1 &kp F &kp N9 &kp N7 &kp N0 &kp SPC>;
        };

        // Cold Face (🥶)
        cold: cold {
            compatible = "zmk,behavior-macro";
            #binding-cells = <0>;
            tap-ms = <0>;
            wait-ms = <0>;
            bindings = <&macro_press &kp LCTRL &kp LSHFT>,
                       <&macro_tap &kp U>,
                       <&macro_release &kp LCTRL &kp LSHFT>,
                       <&macro_tap &kp N1 &kp F &kp N9 &kp N7 &kp N6 &kp SPC>;
        };

        
        // ZZZ (💤)
        zzz: zzz {
            compatible = "zmk,behavior-macro";
            #binding-cells = <0>;
            tap-ms = <0>;
            wait-ms = <0>;
            bindings = <&macro_press &kp LCTRL &kp LSHFT>,
                       <&macro_tap &kp U>,
                       <&macro_release &kp LCTRL &kp LSHFT>,
                       <&macro_tap &kp N1 &kp F &kp N4 &kp A &kp N4 &kp SPC>;
        };
        
        // Skull (💀)
        skull: skull {
            compatible = "zmk,behavior-macro";
            #binding-cells = <0>;
            tap-ms = <0>;
            wait-ms = <0>;
            bindings = <&macro_press &kp LCTRL &kp LSHFT>,
                       <&macro_tap &kp U>,
                       <&macro_release &kp LCTRL &kp LSHFT>,
                       <&macro_tap &kp N1 &kp F &kp N4 &kp N8 &kp N0 &kp SPC>;
        };

        // Crying Face (😢)
        crying: crying {
            compatible = "zmk,behavior-macro";
            #binding-cells = <0>;
            tap-ms = <0>;
            wait-ms = <0>;
            bindings = <&macro_press &kp LCTRL &kp LSHFT>,
                       <&macro_tap &kp U>,
                       <&macro_release &kp LCTRL &kp LSHFT>,
                       <&macro_tap &kp N1 &kp F &kp N6 &kp N2 &kp N2 &kp SPC>;
        };

        // Face Vomiting (🤮)
        vomit: vomit {
            compatible = "zmk,behavior-macro";
            #binding-cells = <0>;
            tap-ms = <0>;
            wait-ms = <0>;
            bindings = <&macro_press &kp LCTRL &kp LSHFT>,
                       <&macro_tap &kp U>,
                       <&macro_release &kp LCTRL &kp LSHFT>,
                       <&macro_tap &kp N1 &kp F &kp N9 &kp N2 &kp E &kp SPC>;
        };

        // Face with Raised Eyebrow (🤨)
        raised_eyebrow: raised_eyebrow {
            compatible = "zmk,behavior-macro";
            #binding-cells = <0>;
            tap-ms = <0>;
            wait-ms = <0>;
            bindings = <&macro_press &kp LCTRL &kp LSHFT>,
                       <&macro_tap &kp U>,
                       <&macro_release &kp LCTRL &kp LSHFT>,
                       <&macro_tap &kp N1 &kp F &kp N9 &kp N2 &kp N8 &kp SPC>;
        };

        // Neutral Face (😐)
        neutral: neutral {
            compatible = "zmk,behavior-macro";
            #binding-cells = <0>;
            tap-ms = <0>;
            wait-ms = <0>;
            bindings = <&macro_press &kp LCTRL &kp LSHFT>,
                       <&macro_tap &kp U>,
                       <&macro_release &kp LCTRL &kp LSHFT>,
                       <&macro_tap &kp N1 &kp F &kp N6 &kp N1 &kp N0 &kp SPC>;
        };

        // Money-Mouth Face (🤑)
        money_mouth: money_mouth {
            compatible = "zmk,behavior-macro";
            #binding-cells = <0>;
            tap-ms = <0>;
            wait-ms = <0>;
            bindings = <&macro_press &kp LCTRL &kp LSHFT>,
                       <&macro_tap &kp U>,
                       <&macro_release &kp LCTRL &kp LSHFT>,
                       <&macro_tap &kp N1 &kp F &kp N9 &kp N1 &kp N1 &kp SPC>;
        };

        // Exploding Head (🤯)
        exploding_head: exploding_head {
            compatible = "zmk,behavior-macro";
            #binding-cells = <0>;
            tap-ms = <0>;
            wait-ms = <0>;
            bindings = <&macro_press &kp LCTRL &kp LSHFT>,
                       <&macro_tap &kp U>,
                       <&macro_release &kp LCTRL &kp LSHFT>,
                       <&macro_tap &kp N1 &kp F &kp N9 &kp N2 &kp F &kp SPC>;
        };

        // Sleeping Face (😴)
        sleep: sleep {
            compatible = "zmk,behavior-macro";
            #binding-cells = <0>;
            tap-ms = <0>;
            wait-ms = <0>;
            bindings = <&macro_press &kp LCTRL &kp LSHFT>,
                       <&macro_tap &kp U>,
                       <&macro_release &kp LCTRL &kp LSHFT>,
                       <&macro_tap &kp N1 &kp F &kp N6 &kp N3 &kp N4 &kp SPC>;
        };

        // Zany Face (🤪)
        zany: zany {
            compatible = "zmk,behavior-macro";
            #binding-cells = <0>;
            tap-ms = <0>;
            wait-ms = <0>;
            bindings = <&macro_press &kp LCTRL &kp LSHFT>,
                       <&macro_tap &kp U>,
                       <&macro_release &kp LCTRL &kp LSHFT>,
                       <&macro_tap &kp N1 &kp F &kp N9 &kp N2 &kp A &kp SPC>;
        };

        // Thumbs Up (👍)
        thumbs_up: thumbs_up {
            compatible = "zmk,behavior-macro";
            #binding-cells = <0>;
            tap-ms = <0>;
            wait-ms = <0>;
            bindings = <&macro_press &kp LCTRL &kp LSHFT>,
                       <&macro_tap &kp U>,
                       <&macro_release &kp LCTRL &kp LSHFT>,
                       <&macro_tap &kp N1 &kp F &kp N4 &kp N4 &kp D &kp SPC>;
        };

        // Thumbs Down (👎)
        thumbs_down: thumbs_down {
            compatible = "zmk,behavior-macro";
            #binding-cells = <0>;
            tap-ms = <0>;
            wait-ms = <0>;
            bindings = <&macro_press &kp LCTRL &kp LSHFT>,
                       <&macro_tap &kp U>,
                       <&macro_release &kp LCTRL &kp LSHFT>,
                       <&macro_tap &kp N1 &kp F &kp N4 &kp N4 &kp E &kp SPC>;
        };

        // Clapping Hands (👏)
        clap: clap {
            compatible = "zmk,behavior-macro";
            #binding-cells = <0>;
            tap-ms = <0>;
            wait-ms = <0>;
            bindings = <&macro_press &kp LCTRL &kp LSHFT>,
                       <&macro_tap &kp U>,
                       <&macro_release &kp LCTRL &kp LSHFT>,
                       <&macro_tap &kp N1 &kp F &kp N4 &kp N4 &kp F &kp SPC>;
        };

        // Left-Facing Fist (🤛)
        fist_left: fist_left {
            compatible = "zmk,behavior-macro";
            #binding-cells = <0>;
            tap-ms = <0>;
            wait-ms = <0>;
            bindings = <&macro_press &kp LCTRL &kp LSHFT>,
                       <&macro_tap &kp U>,
                       <&macro_release &kp LCTRL &kp LSHFT>,
                       <&macro_tap &kp N1 &kp F &kp N9 &kp N1 &kp B &kp SPC>;
        };

        // Right-Facing Fist (🤜)
        fist_right: fist_right {
            compatible = "zmk,behavior-macro";
            #binding-cells = <0>;
            tap-ms = <0>;
            wait-ms = <0>;
            bindings = <&macro_press &kp LCTRL &kp LSHFT>,
                       <&macro_tap &kp U>,
                       <&macro_release &kp LCTRL &kp LSHFT>,
                       <&macro_tap &kp N1 &kp F &kp N9 &kp N1 &kp C &kp SPC>;
        };

        // Crossed Fingers (🤞)
        fingers_crossed: fingers_crossed {
            compatible = "zmk,behavior-macro";
            #binding-cells = <0>;
            tap-ms = <0>;
            wait-ms = <0>;
            bindings = <&macro_press &kp LCTRL &kp LSHFT>,
                       <&macro_tap &kp U>,
                       <&macro_release &kp LCTRL &kp LSHFT>,
                       <&macro_tap &kp N1 &kp F &kp N9 &kp N1 &kp E &kp SPC>;
        };

        // Folded Hands (🙏)
        pray: pray {
            compatible = "zmk,behavior-macro";
            #binding-cells = <0>;
            tap-ms = <0>;
            wait-ms = <0>;
            bindings = <&macro_press &kp LCTRL &kp LSHFT>,
                       <&macro_tap &kp U>,
                       <&macro_release &kp LCTRL &kp LSHFT>,
                       <&macro_tap &kp N1 &kp F &kp N6 &kp N4 &kp F &kp SPC>;
        };

        // Red Heart (❤️)
        red_heart: red_heart {
            compatible = "zmk,behavior-macro";
            #binding-cells = <0>;
            tap-ms = <0>;
            wait-ms = <0>;
            bindings = <&macro_press &kp LCTRL &kp LSHFT>,
                       <&macro_tap &kp U>,
                       <&macro_release &kp LCTRL &kp LSHFT>,
                       <&macro_tap &kp N2 &kp N7 &kp N6 &kp N4 &kp SPC>;
        };

        // Black Heart (🖤)
        black_heart: black_heart {
            compatible = "zmk,behavior-macro";
            #binding-cells = <0>;
            tap-ms = <0>;
            wait-ms = <0>;
            bindings = <&macro_press &kp LCTRL &kp LSHFT>,
                       <&macro_tap &kp U>,
                       <&macro_release &kp LCTRL &kp LSHFT>,
                       <&macro_tap &kp N1 &kp F &kp N5 &kp A &kp N4 &kp SPC>;
        };

        // Heart Hands (🫶)
        heart_hands: heart_hands {
            compatible = "zmk,behavior-macro";
            #binding-cells = <0>;
            tap-ms = <0>;
            wait-ms = <0>;
            bindings = <&macro_press &kp LCTRL &kp LSHFT>,
                       <&macro_tap &kp U>,
                       <&macro_release &kp LCTRL &kp LSHFT>,
                       <&macro_tap &kp N1 &kp F &kp A &kp F &kp N6 &kp SPC>;
        };

        // Sparkling Heart (💖)
        cupid_heart: cupid_heart {
            compatible = "zmk,behavior-macro";
            #binding-cells = <0>;
            tap-ms = <0>;
            wait-ms = <0>;
            bindings = <&macro_press &kp LCTRL &kp LSHFT>,
                       <&macro_tap &kp U>,
                       <&macro_release &kp LCTRL &kp LSHFT>,
                       <&macro_tap &kp N1 &kp F &kp N4 &kp N9 &kp N6 &kp SPC>;
        };

        // Raised Hands (🙌)
        raised_hands: raised_hands {
            compatible = "zmk,behavior-macro";
            #binding-cells = <0>;
            tap-ms = <0>;
            wait-ms = <0>;
            bindings = <&macro_press &kp LCTRL &kp LSHFT>,
                       <&macro_tap &kp U>,
                       <&macro_release &kp LCTRL &kp LSHFT>,
                       <&macro_tap &kp N1 &kp F &kp N6 &kp N4 &kp C &kp SPC>;
        };

        // Waving Hand (👋)
        wave: wave {
            compatible = "zmk,behavior-macro";
            #binding-cells = <0>;
            tap-ms = <0>;
            wait-ms = <0>;
            bindings = <&macro_press &kp LCTRL &kp LSHFT>,
                       <&macro_tap &kp U>,
                       <&macro_release &kp LCTRL &kp LSHFT>,
                       <&macro_tap &kp N1 &kp F &kp N4 &kp N4 &kp B &kp SPC>;
        };

        // Pinched Fingers (🤌)
        pinch: pinch {
            compatible = "zmk,behavior-macro";
            #binding-cells = <0>;
            tap-ms = <0>;
            wait-ms = <0>;
            bindings = <&macro_press &kp LCTRL &kp LSHFT>,
                       <&macro_tap &kp U>,
                       <&macro_release &kp LCTRL &kp LSHFT>,
                       <&macro_tap &kp N1 &kp F &kp N9 &kp N0 &kp F &kp SPC>;
        };

        // Sparkles (✨)
        sparkles: sparkles {
            compatible = "zmk,behavior-macro";
            #binding-cells = <0>;
            tap-ms = <0>;
            wait-ms = <0>;
            bindings = <&macro_press &kp LCTRL &kp LSHFT>,
                       <&macro_tap &kp U>,
                       <&macro_release &kp LCTRL &kp LSHFT>,
                       <&macro_tap &kp N2 &kp N7 &kp N2 &kp N8 &kp SPC>;
        };

        // Middle Finger (🖕)
        middle_finger: middle_finger {
            compatible = "zmk,behavior-macro";
            #binding-cells = <0>;
            tap-ms = <0>;
            wait-ms = <0>;
            bindings = <&macro_press &kp LCTRL &kp LSHFT>,
                       <&macro_tap &kp U>,
                       <&macro_release &kp LCTRL &kp LSHFT>,
                       <&macro_tap &kp N1 &kp F &kp N5 &kp N9 &kp N5 &kp SPC>;
        };

        // Game Die (🎲)
        dice: dice {
            compatible = "zmk,behavior-macro";
            #binding-cells = <0>;
            tap-ms = <0>;
            wait-ms = <0>;
            bindings = <&macro_press &kp LCTRL &kp LSHFT>,
                       <&macro_tap &kp U>,
                       <&macro_release &kp LCTRL &kp LSHFT>,
                       <&macro_tap &kp N1 &kp F &kp N3 &kp B &kp N2 &kp SPC>;
        };

        // Heart with Arrow (💘)
        heart_present: heart_present {
            compatible = "zmk,behavior-macro";
            #binding-cells = <0>;
            tap-ms = <0>;
            wait-ms = <0>;
            bindings = <&macro_press &kp LCTRL &kp LSHFT>,
                       <&macro_tap &kp U>,
                       <&macro_release &kp LCTRL &kp LSHFT>,
                       <&macro_tap &kp N1 &kp F &kp N4 &kp N9 &kp N8 &kp SPC>;
        };

        // Fire (🔥)
        fire: fire {
            compatible = "zmk,behavior-macro";
            #binding-cells = <0>;
            tap-ms = <0>;
            wait-ms = <0>;
            bindings = <&macro_press &kp LCTRL &kp LSHFT>,
                       <&macro_tap &kp U>,
                       <&macro_release &kp LCTRL &kp LSHFT>,
                       <&macro_tap &kp N1 &kp F &kp N5 &kp N2 &kp N5 &kp SPC>;
        };

        // Down Arrow (👇)
        point_down: point_down {
            compatible = "zmk,behavior-macro";
            #binding-cells = <0>;
            tap-ms = <0>;
            wait-ms = <0>;
            bindings = <&macro_press &kp LCTRL &kp LSHFT>,
                       <&macro_tap &kp U>,
                       <&macro_release &kp LCTRL &kp LSHFT>,
                       <&macro_tap &kp N1 &kp F&kp N4 &kp N4 &kp N7 &kp SPC>;
        };

        // Left pointer (👈)
        point_left: point_left {
            compatible = "zmk,behavior-macro";
            #binding-cells = <0>;
            tap-ms = <0>;
            wait-ms = <0>;
            bindings = <&macro_press &kp LCTRL &kp LSHFT>,
                       <&macro_tap &kp U>,
                       <&macro_release &kp LCTRL &kp LSHFT>,
                       <&macro_tap &kp N1 &kp F &kp N4 &kp N4 &kp N8 &kp SPC>;
        };

        // Left pointer (👈)
        point_up: point_up {
            compatible = "zmk,behavior-macro";
            #binding-cells = <0>;
            tap-ms = <0>;
            wait-ms = <0>;
            bindings = <&macro_press &kp LCTRL &kp LSHFT>,
                       <&macro_tap &kp U>,
                       <&macro_release &kp LCTRL &kp LSHFT>,
                       <&macro_tap &kp N2 &kp N6 &kp N1 &kp D &kp SPC>;
        };
        
        // Open Hands (👐)
        palm: palm {
            compatible = "zmk,behavior-macro";
            #binding-cells = <0>;
            tap-ms = <0>;
            wait-ms = <0>;
            bindings = <&macro_press &kp LCTRL &kp LSHFT>,
                       <&macro_tap &kp U>,
                       <&macro_release &kp LCTRL &kp LSHFT>,
                       <&macro_tap &kp N1 &kp F &kp N4 &kp N5 &kp N0 &kp SPC>;
        };

        // Metal
        palm: palm {
            compatible = "zmk,behavior-macro";
            #binding-cells = <0>;
            tap-ms = <0>;
            wait-ms = <0>;
            bindings = <&macro_press &kp LCTRL &kp LSHFT>,
                       <&macro_tap &kp U>,
                       <&macro_release &kp LCTRL &kp LSHFT>,
                       <&macro_tap &kp N1 &kp F &kp N9 &kp N1 &kp N8 &kp SPC>;
        };

        // Call Me Hand (🤙)
        shaka: shaka {
            compatible = "zmk,behavior-macro";
            #binding-cells = <0>;
            tap-ms = <0>;
            wait-ms = <0>;
            bindings = <&macro_press &kp LCTRL &kp LSHFT>,
                       <&macro_tap &kp U>,
                       <&macro_release &kp LCTRL &kp LSHFT>,
                       <&macro_tap &kp N1 &kp F &kp N9 &kp N1 &kp N9 &kp SPC>;
        };

        // Handshake (🤝)
        handshake: handshake {
            compatible = "zmk,behavior-macro";
            #binding-cells = <0>;
            tap-ms = <0>;
            wait-ms = <0>;
            bindings = <&macro_press &kp LCTRL &kp LSHFT>,
                       <&macro_tap &kp U>,
                       <&macro_release &kp LCTRL &kp LSHFT>,
                       <&macro_tap &kp N1 &kp F &kp N9 &kp N1 &kp D &kp SPC>;
        };

        // Writing Hand (✍️)
        writing: writing {
            compatible = "zmk,behavior-macro";
            #binding-cells = <0>;
            tap-ms = <0>;
            wait-ms = <0>;
            bindings = <&macro_press &kp LCTRL &kp LSHFT>,
                       <&macro_tap &kp U>,
                       <&macro_release &kp LCTRL &kp LSHFT>,
                       <&macro_tap &kp N2 &kp N7 &kp N0 &kp D &kp SPC>;
        };

        // Flexed Biceps (💪)
        biceps: biceps {
            compatible = "zmk,behavior-macro";
            #binding-cells = <0>;
            tap-ms = <0>;
            wait-ms = <0>;
            bindings = <&macro_press &kp LCTRL &kp LSHFT>,
                       <&macro_tap &kp U>,
                       <&macro_release &kp LCTRL &kp LSHFT>,
                       <&macro_tap &kp N1 &kp F &kp N4 &kp A &kp A &kp SPC>;
        };

        // Brain (🧠)
        brain: brain {
            compatible = "zmk,behavior-macro";
            #binding-cells = <0>;
            tap-ms = <0>;
            wait-ms = <0>;
            bindings = <&macro_press &kp LCTRL &kp LSHFT>,
                       <&macro_tap &kp U>,
                       <&macro_release &kp LCTRL &kp LSHFT>,
                       <&macro_tap &kp N1 &kp F &kp N9 &kp E &kp N0 &kp SPC>;
        };

        // Face with No Good Gesture (🙅)
        no_hands: no_hands {
            compatible = "zmk,behavior-macro";
            #binding-cells = <0>;
            tap-ms = <0>;
            wait-ms = <0>;
            bindings = <&macro_press &kp LCTRL &kp LSHFT>,
                       <&macro_tap &kp U>,
                       <&macro_release &kp LCTRL &kp LSHFT>,
                       <&macro_tap &kp N1 &kp F &kp N6 &kp N4 &kp N5 &kp SPC>;
        };

        // Facepalm (🤦)
        facepalm: facepalm {
            compatible = "zmk,behavior-macro";
            #binding-cells = <0>;
            tap-ms = <0>;
            wait-ms = <0>;
            bindings = <&macro_press &kp LCTRL &kp LSHFT>,
                       <&macro_tap &kp U>,
                       <&macro_release &kp LCTRL &kp LSHFT>,
                       <&macro_tap &kp N1 &kp F &kp N9 &kp N2 &kp N6 &kp SPC>;
        };
    };
};

